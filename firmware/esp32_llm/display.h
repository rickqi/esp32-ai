// Optional on-device screen for the demo: the story appears on a display wired
// to the ESP32 itself, no laptop. Two panels supported via DISPLAY_KIND:
//
//   DISPLAY_OLED_I2C (default) -- 128x64 I2C mono OLED. 4 wires:
//     GND->GND, VCC->3V3, SCL->GPIO46, SDA->GPIO18. Set OLED_CONTROLLER to match
//     the panel: 1.3" is usually SH1106, 0.96" usually SSD1306. Wrong choice ->
//     top row correct, rest noise (SH1106-as-SSD1306) -> flip the define.
//   DISPLAY_TFT_SPI -- 2.0" 240x320 SPI ST7789 (GMT020-02-7P). Wiring in the TFT
//     block below. Nicer color hero shot for later.
//
// The API (display_begin / display_puts) is identical for both, so the sketch
// integration never changes -- only this header and the wiring.
#ifndef DISPLAY_H
#define DISPLAY_H

#define DISPLAY_OLED_I2C 1
#define DISPLAY_TFT_SPI  2
#define DISPLAY_RLCD_ST7305 3
#ifndef DISPLAY_KIND
#define DISPLAY_KIND DISPLAY_RLCD_ST7305
#endif

// ==================== 128x64 I2C OLED (SH1106 or SSD1306) ===================
#if DISPLAY_KIND == DISPLAY_OLED_I2C
#include <Adafruit_GFX.h>
#include <Wire.h>

// Set to match the panel you wired: 1.3" is usually SH1106, 0.96" usually SSD1306.
// Wrong choice -> shifted/garbled image; just switch this and reflash.
#define OLED_SH1106  1
#define OLED_SSD1306 2
#ifndef OLED_CONTROLLER
#define OLED_CONTROLLER OLED_SH1106
#endif

#define OLED_SDA 18
#define OLED_SCL 46
#define OLED_ADDR 0x3C          // some panels are 0x3D
#define SCR_W 128
#define SCR_H 64
#define CW 6                    // 6x8 base glyph at text size 1
#define CH 8

#if OLED_CONTROLLER == OLED_SH1106
#include <Adafruit_SH110X.h>
static Adafruit_SH1106G oled = Adafruit_SH1106G(SCR_W, SCR_H, &Wire, -1);
#define OLED_WHITE SH110X_WHITE
#else
#include <Adafruit_SSD1306.h>
static Adafruit_SSD1306 oled = Adafruit_SSD1306(SCR_W, SCR_H, &Wire, -1);
#define OLED_WHITE SSD1306_WHITE
#endif

static int ox = 0, oy = 0;

static void display_home() {
  oled.clearDisplay();
  ox = 0; oy = 0;
}

static void display_begin() {
  Wire.begin(OLED_SDA, OLED_SCL);
  Wire.setClock(400000);   // 400kHz fast I2C -> ~4x quicker frame flush than default
#if OLED_CONTROLLER == OLED_SH1106
  oled.begin(OLED_ADDR, true);
#else
  oled.begin(SSD1306_SWITCHCAPVCC, OLED_ADDR);
#endif
  oled.clearDisplay();
  oled.setTextSize(1);
  oled.setTextColor(OLED_WHITE);
  oled.setTextWrap(false);      // we wrap at token boundaries ourselves
  oled.display();
  display_home();
}

// Append a token's bytes; whole-token wrap, clear+home when the screen fills,
// flush the framebuffer once per token so text visibly appears.
static void display_puts(const unsigned char *s, int len) {
  if (ox + len * CW > SCR_W) { oy += CH; ox = 0; }
  if (oy + CH > SCR_H) display_home();
  for (int i = 0; i < len; i++) {
    char c = (char)s[i];
    if (c == '\n') { oy += CH; ox = 0; }
    else if (c >= 32 && c < 127) {
      if (ox + CW > SCR_W) { oy += CH; ox = 0; }
      if (oy + CH > SCR_H) display_home();
      oled.setCursor(ox, oy);
      oled.write(c);
      ox += CW;
    }
    if (oy + CH > SCR_H) display_home();
  }
  oled.display();
}

// Closing stats card shown when generation finishes.
static void display_stats(float tok_s, float ms) {
  oled.clearDisplay();
  oled.setTextColor(OLED_WHITE);
  oled.setTextSize(1);
  oled.setCursor(0, 0);  oled.print("ESP32-S3  PLE LLM");
  oled.setCursor(0, 14); oled.print("28.9M params");
  oled.setCursor(0, 24); oled.print("in 320KB of RAM");
  oled.setTextSize(2);
  oled.setCursor(0, 40); oled.print(tok_s, 1); oled.print(" tok/s");
  oled.setTextSize(1);
  oled.setCursor(0, 57); oled.print(ms, 0); oled.print(" ms/token");
  oled.display();
}

// ======================= 2.0" SPI TFT (ST7789) ==============================
#elif DISPLAY_KIND == DISPLAY_TFT_SPI
#include <Adafruit_GFX.h>
#include <Adafruit_ST7789.h>
#include <SPI.h>

#define TFT_CS 10
#define TFT_DC 7
#define TFT_RST 6
#define TFT_SCK 12
#define TFT_MOSI 11
#define TFT_W 240
#define TFT_H 320
#define TFT_TEXTSIZE 2
#define CHAR_W (6 * TFT_TEXTSIZE)
#define CHAR_H (8 * TFT_TEXTSIZE)
#define LINE_H (CHAR_H + 2)

static Adafruit_ST7789 tft = Adafruit_ST7789(&SPI, TFT_CS, TFT_DC, TFT_RST);

static void display_home() {
  tft.fillScreen(ST77XX_BLACK);
  tft.setCursor(2, 2);
}

static void display_begin() {
  SPI.begin(TFT_SCK, -1, TFT_MOSI, TFT_CS);
  tft.init(TFT_W, TFT_H);
  tft.setRotation(0);
  tft.setTextSize(TFT_TEXTSIZE);
  tft.setTextColor(ST77XX_GREEN, ST77XX_BLACK);
  tft.setTextWrap(false);
  display_home();
}

static void display_puts(const unsigned char *s, int len) {
  if (tft.getCursorX() + len * CHAR_W > TFT_W)
    tft.setCursor(2, tft.getCursorY() + LINE_H);
  if (tft.getCursorY() + LINE_H > TFT_H)
    display_home();
  for (int i = 0; i < len; i++) {
    char c = (char)s[i];
    if (c == '\n') {
      tft.setCursor(2, tft.getCursorY() + LINE_H);
    } else if (c >= 32 && c < 127) {
      if (tft.getCursorX() + CHAR_W > TFT_W)
        tft.setCursor(2, tft.getCursorY() + LINE_H);
      tft.write(c);
    }
    if (tft.getCursorY() + LINE_H > TFT_H)
      display_home();
  }
}

// Closing stats card shown when generation finishes.
static void display_stats(float tok_s, float ms) {
  tft.fillScreen(ST77XX_BLACK);
  tft.setTextColor(ST77XX_GREEN, ST77XX_BLACK);
  tft.setTextSize(2);
  tft.setCursor(4, 10);  tft.print("ESP32-S3");
  tft.setCursor(4, 40);  tft.print("PLE TinyLM");
  tft.setCursor(4, 90);  tft.print("28.9M params");
  tft.setCursor(4, 120); tft.print("in 320KB RAM");
  tft.setTextSize(3);
  tft.setCursor(4, 170); tft.print(tok_s, 1); tft.print(" t/s");
  tft.setTextSize(2);
  tft.setCursor(4, 220); tft.print(ms, 0); tft.print(" ms/token");
}

// ============== 4.2" RLCD ST7305 (Waveshare ESP32-S3-RLCD-4.2) ===============
#elif DISPLAY_KIND == DISPLAY_RLCD_ST7305

#include <stdio.h>
#include <esp_timer.h>
#include "display_bsp.h"

// 5x7 bitmap font (Adafruit GFX classic glcdfont, public domain).
// Indexed as font[ascii * 5 + col]; each byte: bit0 = top row.
static const uint8_t RLCD_FONT[] = {
  0x00, 0x00, 0x00, 0x00, 0x00, 0x3E, 0x5B, 0x4F, 0x5B, 0x3E,
  0x3E, 0x6B, 0x4F, 0x6B, 0x3E, 0x1C, 0x3E, 0x7C, 0x3E, 0x1C,
  0x18, 0x3C, 0x7E, 0x3C, 0x18, 0x1C, 0x57, 0x7D, 0x57, 0x1C,
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  0x00, 0x3C, 0x3C, 0x3C, 0x3C, 0x00, 0x00, 0x00, 0x00, 0x00
};

#define SCR_W 400
#define SCR_H 300
#define CW 6
#define CH 8
#define BORDER_W   2     // border frame width in pixels (thick enough to be visible)
#define TUI_LEFT   1
#define TUI_RIGHT  (SCR_W - 1 - BORDER_W)  // 397
#define TUI_TOP    1
#define TUI_BOT    (SCR_H - 1 - BORDER_W)  // 297
#define TEXT_LEFT  (TUI_LEFT + BORDER_W + 4)   // = 7,  4px padding inside border
#define TEXT_RIGHT (TUI_RIGHT - BORDER_W - 3)  // = 392, 3px padding inside right border

static DisplayPort *rlcd = nullptr;
static int ox = 0, oy = 0;

// Draw one 5x7 glyph at (x,y) into the ST7305 framebuffer (black on white).
static void rlcd_draw_char(int x, int y, unsigned char c) {
  const uint8_t *g = &RLCD_FONT[(unsigned)c * 5];
  for (int col = 0; col < 5; col++) {
    uint8_t bits = g[col];
    for (int row = 0; row < 8; row++) {
      if (bits & (1 << row))
        rlcd->RLCD_SetPixel(x + col, y + row, ColorBlack);
    }
  }
}

// Draw a C string starting at (x,y); handles '\n'.
static void rlcd_draw_text(int x, int y, const char *s) {
  int cx = x, cy = y;
  while (*s) {
    char c = *s++;
    if (c == '\n') { cy += CH; cx = x; }
    else if (c >= 32 && c < 127) {
      rlcd_draw_char(cx, cy, (unsigned char)c);
      cx += CW;
    }
  }
}

static void display_home() {
  rlcd->RLCD_ColorClear(ColorWhite);
  ox = 0; oy = 0;
}

static void display_begin() {
  rlcd = new DisplayPort(12, 11, 5, 40, 41, 400, 300);
  rlcd->RLCD_Init();
  rlcd->RLCD_ColorClear(ColorWhite);
  rlcd->RLCD_Display();
  display_home();
}

// ---- Output area boundaries (3-zone TUI: header / output / footer) ---------
static int out_top = 0;          // first usable row for text output
static int out_bottom = SCR_H;   // exclusive bottom boundary

// Clear a rectangle to white (erase pixels).
static void rlcd_clear_rect(int x0, int y0, int x1, int y1) {
  for (int y = y0; y <= y1; y++) for (int x = x0; x <= x1; x++) rlcd->RLCD_SetPixel(x, y, ColorWhite);
}

// Confine text output to rows [top, bottom).  Call before generation starts.
static void display_set_output_area(int top, int bottom) { out_top = top; out_bottom = bottom; }

// Clear only the output area and reset cursor to its top.
static void display_clear_output() {
  rlcd_clear_rect(TEXT_LEFT, out_top, TEXT_RIGHT, out_bottom - 1);
  ox = TEXT_LEFT; oy = out_top;
}

// Text rendering with wrapping confined to [out_top, out_bottom).
// When the area fills, clears and restarts (simple scroll effect).
// All text is offset by TEXT_LEFT from the left border and wraps at TEXT_RIGHT.
static void display_puts(const unsigned char *s, int len) {
  if (ox + len * CW > TEXT_RIGHT) { oy += CH; ox = TEXT_LEFT; }
  if (oy + CH > out_bottom) display_clear_output();
  for (int i = 0; i < len; i++) {
    char c = (char)s[i];
    if (c == '\n') { oy += CH; ox = TEXT_LEFT; }
    else if (c >= 32 && c < 127) {
      if (ox + CW > TEXT_RIGHT) { oy += CH; ox = TEXT_LEFT; }
      if (oy + CH > out_bottom) display_clear_output();
      rlcd_draw_char(ox, oy, (unsigned char)c);
      ox += CW;
    }
    if (oy + CH > out_bottom) display_clear_output();
  }
  rlcd->RLCD_Display();
}

// Closing stats card shown when generation finishes.
static void display_stats(float tok_s, float ms) {
  rlcd->RLCD_ColorClear(ColorWhite);
  rlcd_draw_text(0, 0,   "ESP32-S3  PLE LLM");
  rlcd_draw_text(0, 12,  "28.9M params");
  rlcd_draw_text(0, 24,  "in 320KB of RAM");
  char buf[32];
  snprintf(buf, sizeof(buf), "%.1f tok/s", tok_s);
  rlcd_draw_text(0, 40, buf);
  snprintf(buf, sizeof(buf), "%.0f ms/token", ms);
  rlcd_draw_text(0, 52, buf);
  rlcd->RLCD_Display();
}

// ---- TUI layout helpers (opencode-inspired) ---------------------------------

// Draw one glyph inverted (white pixel on black background).
static void rlcd_draw_char_inv(int x, int y, unsigned char c) {
  const uint8_t *g = &RLCD_FONT[(unsigned)c * 5];
  for (int col = 0; col < 5; col++) {
    uint8_t bits = g[col];
    for (int row = 0; row < 8; row++)
      if (bits & (1 << row))
        rlcd->RLCD_SetPixel(x + col, y + row, ColorWhite);
  }
}

// Draw inverted text (white on black).
static void rlcd_draw_text_inv(int x, int y, const char *s) {
  int cx = x;
  while (*s) { char c = *s++; if (c >= 32 && c < 127) { rlcd_draw_char_inv(cx, y, (unsigned char)c); cx += CW; } }
}

// Fill a rectangle black.
static void rlcd_fill_rect(int x0, int y0, int x1, int y1) {
  for (int y = y0; y <= y1; y++) for (int x = x0; x <= x1; x++) rlcd->RLCD_SetPixel(x, y, ColorBlack);
}

// Set the text cursor for subsequent display_puts calls.
static void display_set_cursor(int x, int y) { ox = x; oy = y; }

// ---- 2x font (each pixel → 2×2 block) for prominent text -------------------
#define CW2 12   // 2x char cell width  (5*2 + 2 gap)
#define CH2 14   // 2x char cell height (7*2)

static void rlcd_draw_char_2x(int x, int y, unsigned char c) {
  const uint8_t *g = &RLCD_FONT[(unsigned)c * 5];
  for (int col = 0; col < 5; col++) {
    uint8_t bits = g[col];
    for (int row = 0; row < 7; row++) {
      if (bits & (1 << row)) {
        rlcd->RLCD_SetPixel(x+col*2,   y+row*2,     ColorBlack);
        rlcd->RLCD_SetPixel(x+col*2+1, y+row*2,     ColorBlack);
        rlcd->RLCD_SetPixel(x+col*2,   y+row*2+1,   ColorBlack);
        rlcd->RLCD_SetPixel(x+col*2+1, y+row*2+1,   ColorBlack);
      }
    }
  }
}

static void rlcd_draw_char_2x_inv(int x, int y, unsigned char c) {
  const uint8_t *g = &RLCD_FONT[(unsigned)c * 5];
  for (int col = 0; col < 5; col++) {
    uint8_t bits = g[col];
    for (int row = 0; row < 7; row++) {
      if (bits & (1 << row)) {
        rlcd->RLCD_SetPixel(x+col*2,   y+row*2,     ColorWhite);
        rlcd->RLCD_SetPixel(x+col*2+1, y+row*2,     ColorWhite);
        rlcd->RLCD_SetPixel(x+col*2,   y+row*2+1,   ColorWhite);
        rlcd->RLCD_SetPixel(x+col*2+1, y+row*2+1,   ColorWhite);
      }
    }
  }
}

static void rlcd_draw_text_2x(int x, int y, const char *s) {
  int cx = x;
  while (*s) { char c = *s++; if (c >= 32 && c < 127) { rlcd_draw_char_2x(cx, y, (unsigned char)c); cx += CW2; } }
}

static void rlcd_draw_text_2x_inv(int x, int y, const char *s) {
  int cx = x;
  while (*s) { char c = *s++; if (c >= 32 && c < 127) { rlcd_draw_char_2x_inv(cx, y, (unsigned char)c); cx += CW2; } }
}

// ---- Pixel border / frame ---------------------------------------------------
// Draw a BORDER_W-pixel thick rectangle frame.
static void rlcd_draw_rect(int x0, int y0, int x1, int y1) {
  for (int w = 0; w < BORDER_W; w++) {
    int L = x0 + w, R = x1 - w, T = y0 + w, B = y1 - w;
    for (int x = L; x <= R; x++) { rlcd->RLCD_SetPixel(x, T, ColorBlack); rlcd->RLCD_SetPixel(x, B, ColorBlack); }
    for (int y = T; y <= B; y++) { rlcd->RLCD_SetPixel(L, y, ColorBlack); rlcd->RLCD_SetPixel(R, y, ColorBlack); }
  }
}

// Draw the full-screen TUI frame with section dividers.
// Layout: border → header(2x) → div → prompt(2x) → div → output → div → footer → border
// Layout zone positions (pixel rows).  TUI_* are now computed from BORDER_W above.
#define HDR_Y1      3
#define HDR_Y2      16
#define DIV1_Y      17
#define PRM_Y       19
#define DIV2_Y      34
#define OUT_Y       36
#define DIV3_Y      283
#define FTR_Y1      284
#define FTR_Y2      295     // end inside the 2px bottom border (y=296-297)
#define FOOTER_Y    FTR_Y1   // alias for backward compat

static void display_draw_frame() {
  rlcd_draw_rect(TUI_LEFT, TUI_TOP, TUI_RIGHT, TUI_BOT);
  rlcd->RLCD_Display();
}

// Inverted header bar with 2x title (inside the frame).
static void display_draw_header(const char *title) {
  rlcd_fill_rect(TUI_LEFT+1, HDR_Y1, TUI_RIGHT-1, HDR_Y2);
  rlcd_draw_text_2x_inv(5, HDR_Y1+1, title);
  rlcd->RLCD_Display();
}

// Horizontal separator line inside the frame.
static void display_draw_hline(int y) {
  for (int x = TUI_LEFT+1; x < TUI_RIGHT; x++) rlcd->RLCD_SetPixel(x, y, ColorBlack);
  rlcd->RLCD_Display();
}

// Draw 2x prompt text (e.g. "> The dragon").
static void display_draw_prompt_2x(const char *prefix, const unsigned char *body, int bodylen) {
  int cx = 5;
  // prefix (e.g. "> ")
  while (*prefix) { char c = *prefix++; if (c >= 32 && c < 127) { rlcd_draw_char_2x(cx, PRM_Y, (unsigned char)c); cx += CW2; } }
  // body (the prompt token bytes)
  for (int i = 0; i < bodylen && cx < TUI_RIGHT - CW2; i++) {
    char c = body[i];
    if (c >= 32 && c < 127) { rlcd_draw_char_2x(cx, PRM_Y, (unsigned char)c); cx += CW2; }
  }
  rlcd->RLCD_Display();
}

// Inverted footer bar: fixed-position, fixed-width fields.
// All fields occupy PRECISE pixel positions, no wrapping, no overflow.
// Layout (CW=6):  TP=7ch | Ms=5ch | MP=5ch | HW=8ch | [flex] | DT=10ch(right-aligned)
static void display_draw_footer(float tok_s, float ms) {
  rlcd_fill_rect(TUI_LEFT, FTR_Y1, TUI_RIGHT, FTR_Y2);
  int x = TEXT_LEFT, y = FTR_Y1 + 2;
  // Throughput: "%5.1f" + "t/s" = 7 chars at fixed x
  char buf[16];
  snprintf(buf, sizeof(buf), "%5.1ft/s", tok_s);  // " 9.5t/s" or "10.5t/s" (7 chars)
  rlcd_draw_text_inv(x, y, buf);
  // Latency: "%3.0f" + "ms" = 5 chars at x+7*CW+6 = x+48
  snprintf(buf, sizeof(buf), "%3.0fms", round(ms));
  rlcd_draw_text_inv(x + 48, y, buf);
  // Model: "28.9M" (5 chars) at x+48+5*CW+6 = x+48+36 = x+84
  rlcd_draw_text_inv(x + 84, y, "28.9M");
  // Hardware: "S3-N16R8" (8 chars) at x+84+5*CW+6 = x+84+36 = x+120
  rlcd_draw_text_inv(x + 120, y, "S3-N16R8");
  // Date/time (placeholder: uptime as UP+hh:mm, right-anchored, 8 chars)
  uint64_t uptime_us = esp_timer_get_time();
  int up_hrs = (int)(uptime_us / 3600000000ULL);
  int up_min = (int)((uptime_us / 60000000ULL) % 60);
  snprintf(buf, sizeof(buf), "UP%02d:%02d", up_hrs, up_min);  // "UP00:05" (8 chars)
  rlcd_draw_text_inv(TEXT_RIGHT - 8 * CW, y, buf);  // right-anchored at TEXT_RIGHT-48
  rlcd->RLCD_Display();
}

#endif
#endif
